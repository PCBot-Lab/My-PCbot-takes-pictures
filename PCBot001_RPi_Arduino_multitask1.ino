// generated by mBlock 5.4.0 for mBot MCore, Orion, Auriga and MegaPi boards
// MegaPi board (using "Maker's Platform" extension for mBot Ultimate robot)
// MegaPi board with four RJ25 ports (5, 6, 7 and 8)
// improved by PCBot-Lab on 23Dec2022
//credits for my Udemy class Arduino Raspberry Pi by Robotics backend   

// Select Port: '/dev/ttyUSB0'
#include <MeMCore.h>   // Makeblock mBot 
//#include <MeOrion.h>   // Makeblock Starter/Ultimate robot kit
//#include <MeAuriga.h>  // Makeblock mBot Ranger
//#include <MeMegaPi.h>  // Makeblock mBot Ultimate 2.0, mBot Mega (with Shield for RJ25)
#include <Arduino.h>

MeLineFollower linefollower_1(1);
int both_over_line = 0;
int left_over_right_out_line = 1;
int right_over_left_out_line = 2;
int both_out_line = 3;

MeLEDMatrix ledMtx_2(2);
unsigned char drawBuffer[16];
unsigned char *drawTemp;

MeUltrasonicSensor ultrasonic_3(3);

MePort port(4); // MePort port_4(4); generated by mBlock for port=4 
Servo servo1; // Servo servo_4_1; generated by mBlock for port=4
Servo servo2; // Servo servo_4_2; generated by mBlock for port=4
int angle_pan = 0;
int angle_tilt = 0;

MeRGBLed rgbled_7(7, 2);
float color1 = 150;
float color2 = 150;
float color3 = 150;

MeDCMotor motor_9(9);      //motor port1 - left respect to driver
MeDCMotor motor_10(10);  //motor port2 - right respect to driver

MeBuzzer buzzer;

unsigned long endTime = millis();

void _loop() {
}

void _delay(float seconds) {
  endTime = millis() + seconds * 1000;
  while(millis() < endTime) _loop();
}

void Line_follower (){
  if(linefollower_1.readSensors() == both_over_line){ //move forward
      motor_9.run(-1*60/100.0*255);                              //anticlockwise
      motor_10.run(1*60/100.0*255);                             //clockwise

  }else{
      if(linefollower_1.readSensors() == left_over_right_out_line){ //turn left
          motor_9.run(-1*0/100.0*255);                           //anticlockwise
          motor_10.run(1*50/100.0*255);                        //clockwise

      }else{
          if(linefollower_1.readSensors() == right_over_left_out_line){ //turn right
              motor_9.run(-1*50/100.0*255);                     //anticlockwise
              motor_10.run(1*0/100.0*255);                       //clockwise

          }else{
              if(linefollower_1.readSensors() == both_out_line){ //move backward
                  motor_9.run(1*40/100.0*255);                  //clockwise
                  motor_10.run(-1*40/100.0*255);               //anticlockwise
              }
          }
      }
  }
}

void LED_panel_RGB_show_label_text (){

  drawTemp = new unsigned char[16]{0,0,60,126,126,60,0,0,0,0,60,126,126,60,0,0};
  memcpy(drawBuffer, drawTemp, 16);
  free(drawTemp);
  ledMtx_2.drawBitmap(0, 0, 16, drawBuffer);
  _delay(0.2);
  ledMtx_2.clearScreen();
  color1 += random(-100, 100 +1);
  color2 += random(-100, 100 +1);
  color3 += random(-100, 100 +1);

  rgbled_7.setColor(0, color1, color2, color3);
  rgbled_7.show();
}

void servos_position (){
  int angle = 90;
  servo1.write(angle);
  servo2.write(angle);
}

void setup() {
  
  Serial.begin(115200);
  while (!Serial) {}
  
  servo1.attach(port.pin1());
  servo2.attach(port.pin2()); 
    
  rgbled_7.fillPixelsBak(0, 2, 1);
  ledMtx_2.setColorIndex(1);
  ledMtx_2.setBrightness(6);
  
}

void loop() {
  
  if(ultrasonic_3.distanceCm() > 10){
    rgbled_7.setColor(0, 0, 0, 0);
    rgbled_7.show();
    ledMtx_2.clearScreen();
    Line_follower(); 

    if (Serial.available() > 0) {   
      String cmd=Serial.readStringUntil('\n'); //Txd by RPi and Rxd by Arduino 
      int i= cmd.toInt();
      angle_pan =  i * 4;              // initial pos = 0, goes from 0 degrees to 180 degrees 
      angle_tilt = 45 + 2*i;         // initial pos = 45, goes from 45 degrees to 135 degrees
      servo1.write(angle_pan); 
      servo2.write(angle_tilt);
      
      String Rx1="counter= "+String(i);
      String Rx2="angle_pan = "+String(angle_pan);
      String Rx3="angle_tilt = "+String(angle_tilt);
      String Rx= Rx1+'\t'+Rx2+'\t'+'\t'+Rx3;
      Serial.println(Rx); //Txd by Arduino and Rxd by RPi
      }
    }
    else{
      motor_9.run(0);
      motor_10.run(0);
      buzzer.tone(262, 0.5 * 1000);
       _delay(0.02);
      LED_panel_RGB_show_label_text();
       servos_position();
    }
}
